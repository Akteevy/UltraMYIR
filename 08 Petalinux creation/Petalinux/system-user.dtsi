/include/ "system-conf.dtsi"
/{
};
&gem3 { 
	status = "okay";
	phy-handle = <&phy0>;
	phy-mode = "rgmii-id";

	phy0: ethernet-phy@5 {
		#phy-cells = <1>;
		reg = <5>;
		device_type="ethernet-phy";
		ti,rx-internal-delay = <0x8>;
		ti,tx-internal-delay = <0xa>;
		ti,fifo-depth = <0x1>;
		ti,dp83867-rxctrl-strap-quirk;
	};
};

&sdhci1 {
      no-1-8-v;
      disable-wp;
};
